## source/application/rt-thread/d133_hmi/Kconfig
```kconfig
config HMI_FW_VERSION
    string "D133-控制终端 firmware semantic version"
    default "1.0.0"

config HMI_APP
    bool
    default y

config HMI_QUIET_CONSOLE
    bool "Silence RT-Thread console in production"
    depends on HMI_APP
    default n

config HMI_DISPLAY_PROFILE_SERIAL
    bool "Enable UART0 panel profile commands"
    depends on HMI_APP && HMI_QUIET_CONSOLE
    select AIC_USING_UART0
    default y

config HMI_SERIAL_DIAGNOSTICS
    bool "Enable HMI serial diagnostics"
    depends on HMI_APP
    default n

config HMI_NETWORK
    bool "Enable D133 toolbox TCP OTA server"
    default n
config HMI_UI
    bool "Enable D133-控制终端 application UI"
    default n
    select LPKG_USING_FREETYPE
config HMI_SD_OTA
    bool "Enable SD OTA shell entry"
    default n
```

## source/target/configs/d13x_d133cbv-hmi-nor_rt-thread_d133_hmi_defconfig
```kconfig
CONFIG_PRJ_DEFCONFIG_FILENAME="d13x_d133cbv-hmi-nor_rt-thread_d133_hmi_defconfig"
CONFIG_PRJ_CHIP="d13x"
CONFIG_PRJ_BOARD="d133cbv-hmi-nor"
CONFIG_PRJ_KERNEL="rt-thread"
CONFIG_PRJ_APP="d133_hmi"
CONFIG_AIC_USING_FS_IMAGE_0=y
CONFIG_AIC_USING_FS_IMAGE_TYPE_FATFS_FOR_0=y
CONFIG_AIC_FS_IMAGE_DIR_0="rodata/"
CONFIG_AIC_FS_IMAGE_NAME_0="rodata.fatfs"
CONFIG_AIC_USING_FS_IMAGE_1=y
CONFIG_AIC_FS_IMAGE_DIR_1="data/"
CONFIG_AIC_FS_IMAGE_NAME_1="data.lfs"
CONFIG_LVGL_V_9=y
# CONFIG_AIC_LVGL_DEMO is not set

CONFIG_LV_COLOR_DEPTH=16
CONFIG_LV_CACHE_IMG_NUM=8
CONFIG_AIC_USING_I2C2=y
# CONFIG_AIC_USING_CAN0 is not set
CONFIG_AIC_USING_QSPI0=y
CONFIG_AIC_QSPI0_DEVICE_SPINOR=y
CONFIG_AIC_QSPI0_DEVICE_SPINOR_FREQ=100000000
CONFIG_AIC_DEV_QSPI0_MAX_SRC_FREQ_HZ=100000000
CONFIG_AIC_QSPI0_BUS_WIDTH_4=y
CONFIG_AIC_DEV_QSPI0_DELAY_MODE=2
# CONFIG_AIC_USING_TSEN is not set
# CONFIG_AIC_USING_TSEN_CPU is not set
# CONFIG_AIC_USING_TSEN_GPAI is not set
CONFIG_AIC_USING_GPAI=y
CONFIG_AIC_USING_GPAI2=y
# CONFIG_AIC_USING_GPAI7 is not set
CONFIG_AIC_DISP_LVDS_SINGLE=y
CONFIG_AIC_PANEL_DSI_ILI9881C=y
CONFIG_ILI9881C_04_DEFAULT=y
CONFIG_AICFB_RGB565=y
CONFIG_AIC_PAN_DISPLAY=y
CONFIG_AIC_DISP_BOOTUP_LOGO=y
# CONFIG_AIC_DISP_COLOR_BLOCK is not set
CONFIG_AIC_DISP_BLACK_SCREEN=y
# CONFIG_AIC_STARTUP_UI_SHOW is not set
CONFIG_AIC_PANEL_ENABLE_GPIO="PE.13"
# CONFIG_AIC_USING_AUDIO is not set
CONFIG_AIC_USING_DMA=y
CONFIG_AIC_USING_WRI=y
CONFIG_AIC_USING_RTC=y
CONFIG_AIC_USING_WDT=y
CONFIG_AIC_PSRAM_SW_SIZE=0x0
CONFIG_AIC_INTERRUPTSTACK_SIZE=4096
CONFIG_AIC_CLK_PLL_FRA0_FREQ=792000000
CONFIG_AIC_CLK_PLL_FRA2_FREQ=1188000000
CONFIG_AIC_CLK_PLL_INT0_FREQ=480000000
CONFIG_AIC_CLK_PLL_INT1_FREQ=1200000000
CONFIG_AIC_CLK_CPU_FREQ=480000000
CONFIG_AIC_CLK_AXI0_FREQ=200000000
CONFIG_AIC_CLK_AHB0_FREQ=200000000
CONFIG_AIC_CLK_APB0_FREQ=100000000
CONFIG_AIC_USING_SID=y
CONFIG_AIC_USING_MTOP=y
CONFIG_AIC_USING_PSADC=y
CONFIG_AIC_USING_PSADC6=y
CONFIG_IDLE_THREAD_STACK_SIZE=1024
# CONFIG_RT_KSERVICE_USING_STDLIB is not set
# CONFIG_RT_DEBUG is not set
CONFIG_RT_MEMHEAP_BSET_MODE=y
CONFIG_RT_USING_MEMHEAP_AS_HEAP=y
# CONFIG_RT_USING_MEMHEAP_AUTO_BINDING is not set
CONFIG_RT_CONSOLE_DEVICE_NAME="hmi_quiet"
# CONFIG_RT_USING_MSH is not set
# CONFIG_RT_USING_FINSH is not set
CONFIG_RT_MAIN_THREAD_STACK_SIZE=4096
CONFIG_DFS_FILESYSTEMS_MAX=8
CONFIG_RT_USING_DFS_MNTTABLE=y
CONFIG_RT_USING_DFS_ELMFAT=y
CONFIG_RT_DFS_ELM_LFN_UNICODE_2=y
CONFIG_RT_DFS_ELM_USE_EXFAT=y
CONFIG_RT_DFS_ELM_DRIVES=4
CONFIG_RT_DFS_ELM_MAX_SECTOR_SIZE=4096
CONFIG_RT_USING_DFS_ROMFS=y
CONFIG_RT_USING_FAL=y
CONFIG_FAL_USING_SFUD_PORT=y
# CONFIG_FAL_BLK_DEVICE_RDONLY is not set
CONFIG_RT_USING_PWM=y
CONFIG_AIC_USING_PWM1=y
CONFIG_RT_USING_PM=y
CONFIG_PM_USING_CUSTOM_CONFIG=y
CONFIG_PM_ENABLE_SUSPEND_SLEEP_MODE=y
CONFIG_PM_ENABLE_THRESHOLD_SLEEP_MODE=y
CONFIG_RT_MMCSD_STACK_SIZE=8192
CONFIG_RT_SFUD_USING_QSPI=y
CONFIG_RT_USING_TOUCH=y
CONFIG_RT_TOUCH_PIN_IRQ=y
CONFIG_RT_USING_ULOG=y
CONFIG_ULOG_OUTPUT_LVL_A=y
# CONFIG_ULOG_USING_FILTER is not set
CONFIG_ULOG_TIME_USING_TIMESTAMP=y
CONFIG_LPKG_USING_CPU_USAGE=y
CONFIG_LPKG_USING_LITTLEFS=y
CONFIG_AIC_MPP_PLAYER_INTERFACE=y
CONFIG_AIC_MPP_PLAYER_VIDEO_EXT_RENDER=y
CONFIG_AIC_GPIO_IRQ_DRV_EN=y
CONFIG_AIC_USING_TOUCH=y
CONFIG_AIC_TOUCH_PANEL_I2C_CHAN="i2c2"
CONFIG_AIC_TOUCH_PANEL_RST_PIN="PA.10"
CONFIG_AIC_TOUCH_PANEL_INT_PIN="PA.11"
# CONFIG_AIC_CMU_DRV_TEST is not set
# CONFIG_AIC_GPIO_DRV_TEST is not set
# CONFIG_AIC_DMA_DRV_TEST is not set
# CONFIG_AIC_CAN_DRV_TEST is not set
# CONFIG_AIC_AUDIO_DRV_TEST is not set
# CONFIG_AIC_GPAI_TEST is not set
# CONFIG_AIC_TSEN_TEST is not set
# CONFIG_AIC_PSADC_TEST is not set


CONFIG_AIC_USING_SDMC1=y
CONFIG_AIC_SDMC1_USING_HOTPLUG=y
CONFIG_AIC_SDMC1_HOTPLUG_PIN="PC.6"



CONFIG_AIC_ENV_INTERFACE=y
CONFIG_AIC_AB_SYSTEM_INTERFACE=y
CONFIG_AIC_HMI_HEALTH_CONFIRM=y
CONFIG_LPKG_USING_OTA_DOWNLOADER=y
CONFIG_OTA_DATA_DIRECT=y
CONFIG_LPKG_USING_MBEDTLS=y
CONFIG_HMI_APP=y
CONFIG_HMI_QUIET_CONSOLE=y
CONFIG_AIC_USING_UART0=y
CONFIG_HMI_DISPLAY_PROFILE_SERIAL=y

CONFIG_HMI_SD_OTA=y
CONFIG_HMI_NETWORK=y
CONFIG_AIC_USING_GMAC0=y
CONFIG_AIC_DEV_GMAC0_RMII=y
CONFIG_AIC_DEV_GMAC0_PHY_EXTCLK=y
CONFIG_AIC_DEV_GMAC0_PHYRST_GPIO="PE.6"
CONFIG_AIC_DEV_GMAC0_PHYADDR=1
CONFIG_AIC_USING_CLK_OUT2=y
CONFIG_AIC_CLK_OUT2_FREQ=25000000
CONFIG_RT_USING_LWIP=y
CONFIG_RT_USING_NETDEV=y
CONFIG_RT_LWIP_DHCP=y
CONFIG_HMI_UI=y
CONFIG_LPKG_USING_LVGL=y
CONFIG_LPKG_LVGL_THREAD_STACK_SIZE=32768
CONFIG_HMI_FW_VERSION="1.0.46"
CONFIG_LV_FONT_MONTSERRAT_16=y
CONFIG_LV_FONT_DEFAULT_MONTSERRAT_20=y
CONFIG_LVGL_STORAGE_PATH="/rodata/hmi"
CONFIG_LPKG_USING_FREETYPE=y
```
